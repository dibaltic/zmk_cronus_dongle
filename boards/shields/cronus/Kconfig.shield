## boards/shields/cronus/Kconfig.shield
```kconfig
# No whitespace after the comma or in the keyboard name!
config SHIELD_CRONUS_DONGLE
    def_bool $(shields_list_contains,cronus_dongle)

# No whitespace after the comma or in your part name!
config SHIELD_CRONUS_LEFT
    def_bool $(shields_list_contains,cronus_left)

# No whitespace after the comma or in your part name!
config SHIELD_CRONUS_RIGHT
    def_bool $(shields_list_contains,cronus_right)
```
